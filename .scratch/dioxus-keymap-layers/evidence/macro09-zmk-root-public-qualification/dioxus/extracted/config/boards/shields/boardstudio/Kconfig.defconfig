## .scratch/dioxus-keymap-layers/evidence/macro09-zmk-root-public-qualification/dioxus/extracted/config/boards/shields/boardstudio/Kconfig.defconfig
```kconfig
if SHIELD_BOARDSTUDIO_LEFT
config ZMK_SPLIT
    default y
config ZMK_SPLIT_ROLE_CENTRAL
    default y

endif
if SHIELD_BOARDSTUDIO_RIGHT
config ZMK_SPLIT
    default y
config ZMK_SPLIT_ROLE_CENTRAL
    default n

endif
```

## .scratch/dioxus-keymap-layers/evidence/macro09-zmk-root-public-qualification/dioxus/extracted/config/boards/shields/boardstudio/Kconfig.shield
```kconfig
config SHIELD_BOARDSTUDIO
    def_bool $(shields_list_contains,boardstudio)

config SHIELD_BOARDSTUDIO_LEFT
    def_bool $(shields_list_contains,boardstudio_left)

config SHIELD_BOARDSTUDIO_RIGHT
    def_bool $(shields_list_contains,boardstudio_right)
```
